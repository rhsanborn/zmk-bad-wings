/* source key position labels */
#include "zmk-helpers/key-labels/36.h"

/* map Zen's extra keys */
#define X_LH  &lt FN ESC     // thumb row, left
#define X_RH  &bspc_del  // thumb row, right

/* source the main keymap */
//#include "base.keymap"
#include "base_miryoku_qwerty_vim.keymap"

/* use 5-column layout for Zen */
/{ chosen { zmk,physical-layout = &foostan_corne_5col_layout; }; };
